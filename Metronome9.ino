/*
Betty Metronome, named after Betty Davis, the funk queen
Roni Bandini, Argentina 2021
@RoniBandini

Buzzer: D7 and GND
Gesture: VCC, GND, SDA D2, SCL D1
VIN: 5V and GND

*/
 
#include <DFRobot_PAJ7620U2.h>
#include <U8g2lib.h>
#ifdef U8X8_HAVE_HW_SPI
#include <SPI.h>
#endif
#ifdef U8X8_HAVE_HW_I2C
#include <Wire.h>
#endif

U8G2_SSD1306_128X32_UNIVISION_F_SW_I2C u8g2(U8G2_R0, /* clock=*/ 5, /* data=*/ 4, /* reset=*/ 16);

DFRobot_PAJ7620U2 paj;

int pinBuzzer=D7;
float bpm=100;
int soundOn=0;
int beepFreq=60;
int animation=1;

static const unsigned char logo[] = {
  0x00, 0x00, 0x00, 0x00, 0x00, 0x00, 0x00, 0x00, 0x00, 0x00, 0x00, 0x00, 
  0x00, 0x00, 0x00, 0x00, 0x00, 0x00, 0x00, 0x00, 0x00, 0x00, 0x00, 0x00, 
  0x00, 0x00, 0x00, 0x00, 0x00, 0x00, 0x00, 0x00, 0x00, 0x00, 0x00, 0x00, 
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  0x00, 0x00, 0x00, 0x00, 0x00, 0x00, 0x00, 0x00, };

//#define 1616724093912_width 32 x 27 
static const unsigned char metro1[] = {
  0x00, 0x04, 0x00, 0x08, 0x00, 0x00, 0x00, 0x00, 0x00, 0x80, 0x00, 0x00, 
  0x20, 0xC0, 0x01, 0x00, 0x00, 0xC0, 0x01, 0x00, 0x01, 0xE0, 0x03, 0x01, 
  0x00, 0xE0, 0x87, 0x0F, 0x00, 0x70, 0x87, 0x1F, 0x00, 0x38, 0xEE, 0x1C, 
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  0xFC, 0xFF, 0xFF, 0x1F, 0x00, 0x00, 0x00, 0x00, 0x00, 0x00, 0x00, 0x00, 
  };

static const unsigned char metro2[] = {
  0x00, 0x00, 0x00, 0x01, 0x00, 0x00, 0x00, 0x00, 0x00, 0x00, 0x01, 0x10, 
  0x20, 0x80, 0x03, 0x00, 0x00, 0x80, 0x03, 0x00, 0x40, 0xC0, 0x07, 0x00, 
  0xF0, 0xC1, 0x07, 0x02, 0xF0, 0xE3, 0x0E, 0x00, 0x38, 0x77, 0x1C, 0x00, 
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  0xF8, 0xFF, 0xFF, 0x3F, 0x00, 0x00, 0x00, 0x00, 0x00, 0x00, 0x00, 0x00, 
  };

unsigned long start=0;
unsigned long end=0; 

  
void setup()
{
  Serial.begin(115200);
  delay(300);
  Serial.println("Betty started");

  u8g2.begin();   
  u8g2.clearBuffer();               
  u8g2.drawXBM(0,0, 128, 32, logo);
  u8g2.sendBuffer();          
  delay(3000);
  
  u8g2.clearBuffer();   
  u8g2.setFont(u8g2_font_t0_11_tf);  
  u8g2.drawStr(0,10,"Betty Metronome");  
  u8g2.drawStr(0,20,"Developed by");   
  u8g2.drawStr(0,30,"@RoniBandini");    
  u8g2.sendBuffer();           
  delay(2000);
  
  
  while(paj.begin() != 0){
    Serial.println("PAJ7620U2 failure! Check if all the connections are fine");
    delay(500);
  }

  paj.setGestureHighRate(true);

}

void loop()
{

  DFRobot_PAJ7620U2::eGesture_t gesture = paj.getGesture();       
  
  if(gesture != paj.eGestureNone ){
    // "None","Right","Left", "Up", "Down", "Forward", "Backward", "Clockwise", "Anti-Clockwise", "Wave", "WaveSlowlyDisorder", "WaveSlowlyLeftRight", "WaveSlowlyUpDown", "WaveSlowlyForwardBackward"
    String description  = paj.gestureDescription(gesture);    
    Serial.println(description);
    
    if (description=="Right"){
      Serial.print("Start");
      soundOn=1;      
      start = micros();      
    }

    if (description=="Left"){
      Serial.print("Stop");
      soundOn=0;         
    }

    if (description=="Up"){
      Serial.print("Up");
      bpm=bpm+5; 
    }
      

    if (description=="Down"){
      Serial.print("Down");
      bpm=bpm-5; 
 
    }

    
  } // gesture detected

     printScreen();  
     if (soundOn==1){      
      tone(pinBuzzer, beepFreq);
      delay(10);
      noTone(pinBuzzer);
    }

   unsigned long myDelay=(1000)/(bpm/60);
   unsigned long time_now;
   Serial.println("Delay: "+String(myDelay)+" ms");
   
   time_now = millis();

    while(millis() < time_now + myDelay){
        // waiting 
    }   
  
}

void printScreen(){
     
      u8g2.clearBuffer();        
      u8g2.drawStr(0,10,"Betty Metronome");             
      u8g2.drawStr(0,20,"Tempo:");  
      u8g2.drawStr(38,20,String(int(bpm)).c_str());                  
      u8g2.drawStr(60,20,"BPM");                  

      unsigned long delta=0; 

     if (soundOn==1){ 
      
      end = micros();
      delta = (end - start)/1000000;
      Serial.println(delta); 
      
      if (animation==1){        
        u8g2.drawXBM(90,5, 32, 27, metro1);
        animation=2;
      }
      else
      {     
         u8g2.drawXBM(90,5, 32, 27, metro2);
         animation=1;
        }
     }

     u8g2.drawStr(0,30,"Playing:");  
     u8g2.drawStr(50,30,String(delta).c_str()); 
     u8g2.sendBuffer();    
}
        
